## config/boards/shields/avocado/Kconfig.shield
```kconfig
config SHIELD_AVOCADO_LEFT
    def_bool $(shields_list_contains,avocado)

config SHIELD_AVOCADO_RIGHT
    def_bool $(shields_list_contains,avocado)
```
