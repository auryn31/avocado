#include "avocado.dtsi"

&default_transform {
    col-offset = <5>;
};

&default_kscan {
    col-gpios = <&xiao_d 8 GPIO_ACTIVE_HIGH>,
                <&xiao_d 5 GPIO_ACTIVE_HIGH>,
                <&xiao_d 4 GPIO_ACTIVE_HIGH>,
                <&xiao_d 3 GPIO_ACTIVE_HIGH>,
                <&xiao_d 2 GPIO_ACTIVE_HIGH>;
};

&right_encoder {
    status = "okay";
};

