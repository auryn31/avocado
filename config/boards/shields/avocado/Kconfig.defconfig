## config/boards/shields/avocado/Kconfig.defconfig
```kconfig
if SHIELD_AVOCADO_RIGHT

config ZMK_KEYBOARD_NAME
    default "Avocado v0.3"

config ZMK_SPLIT_ROLE_CENTRAL
    default y

config ZMK_USB
    default y

endif

if SHIELD_AVOCADO_LEFT || SHIELD_AVOCADO_RIGHT

config CONFIG_EC11
  default y
config CONFIG_EC11_TRIGGER_GLOBAL_THREAD
  default y

config ZMK_SPLIT
    default y

endif
```

## config/west.yml
```yaml
manifest:
  remotes:
    - name: zmkfirmware
      url-base: https://github.com/zmkfirmware
    - name: infused-kim
      url-base: https://github.com/infused-kim
    - name: petejohanson
      url-base: https://github.com/petejohanson
    - name: urob
      url-base: https://github.com/urob

  projects:
    - name: zmk
      remote: infused-kim
      revision: pr-testing/mouse_ps2_module_base
      import: app/west.yml

    - name: kb_zmk_ps2_mouse_trackpoint_driver
      remote: infused-kim
      revision: main

  self:
    path: config
```

## zmk/config/boards/shields/josukey/Kconfig.shield
```kconfig
config SHIELD_AVOCADO_LEFT
    def_bool $(shields_list_contains,avocado_left)

config SHIELD_AVOCADO_RIGHT
    def_bool $(shields_list_contains,avocado_right)
```
