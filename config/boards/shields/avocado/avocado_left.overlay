#include "avocado.dtsi"

&default_kscan {
    col-gpios = <&xiao_d 10 GPIO_ACTIVE_HIGH>,
                <&xiao_d 16 GPIO_ACTIVE_HIGH>,
                <&xiao_d 14 GPIO_ACTIVE_HIGH>,
                <&xiao_d 15 GPIO_ACTIVE_HIGH>,
                <&xiao_d 18 GPIO_ACTIVE_HIGH>;
};
